## technologic/package/ts7680-utils/Config.in
```kconfig
config BR2_PACKAGE_TS7680_UTILS
	bool "ts7680-utils"
	select BR2_PACKAGE_LIBGPIOD
	select BR2_PACKAGE_LIBGPIOD_TOOLS
	help
	  Utilities tools for TS-7680 SBC.

	  Includes tools to communicate with the supervisory
	  microcontroller, TS-SILO monitor script, and switch IC.
```
