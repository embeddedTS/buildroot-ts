## technologic/package/nxp-bt-wifi-firmware-ets/Config.in
```kconfig
config BR2_PACKAGE_NXP_BT_WIFI_FIRMWARE_ETS
	bool "nxp-bt-wifi-firmware-ets"
	help
	  Firmwares for NXP Bluetooth / WiFi chipsets based modules

	  https://github.com/nxp-imx/imx-firmware

if BR2_PACKAGE_NXP_BT_WIFI_FIRMWARE_ETS

config BR2_PACKAGE_NXP_BT_WIFI_FIRMWARE_ETS_8801
	bool "8801 (SD)"
	help
	  NXP 8801 module firmware files.

config BR2_PACKAGE_NXP_BT_WIFI_FIRMWARE_ETS_8987
	bool "8987 (SD)"
	help
	  NXP 8987 module firmware files.

config BR2_PACKAGE_NXP_BT_WIFI_FIRMWARE_ETS_8997
	bool "8997"
	help
	  NXP 8997 module firmware files.

if BR2_PACKAGE_NXP_BT_WIFI_FIRMWARE_ETS_8997

choice
	prompt "8997 WiFi interface"

config BR2_PACKAGE_NXP_BT_WIFI_FIRMWARE_ETS_8997_SD
	bool "SD"

config BR2_PACKAGE_NXP_BT_WIFI_FIRMWARE_ETS_8997_PCIE
	bool "PCIe"

endchoice

endif

config BR2_PACKAGE_NXP_BT_WIFI_FIRMWARE_ETS_9098
	bool "9098"
	help
	  NXP 9098 module firmware files.

if BR2_PACKAGE_NXP_BT_WIFI_FIRMWARE_ETS_9098

choice
	prompt "9098 WiFi interface"

config BR2_PACKAGE_NXP_BT_WIFI_FIRMWARE_ETS_9098_SD
	bool "SD"

config BR2_PACKAGE_NXP_BT_WIFI_FIRMWARE_ETS_9098_PCIE
	bool "PCIe"

endchoice

endif

config BR2_PACKAGE_NXP_BT_WIFI_FIRMWARE_ETS_IW416
	bool "IW416 (SD)"
	help
	  NXP IW416 module firmware files.

config BR2_PACKAGE_NXP_BT_WIFI_FIRMWARE_ETS_IW610
	bool "IW610 (SD)"
	help
	  NXP IW610 module firmware files.

config BR2_PACKAGE_NXP_BT_WIFI_FIRMWARE_ETS_IW612
	bool "IW612 (SD)"
	help
	  NXP IW612 module firmware files.

endif
```

## technologic/package/ts4100-utils/Config.in
```kconfig
config BR2_PACKAGE_TS4100_UTILS
	bool "ts4100-utils"
	select BR2_PACKAGE_LIBGPIOD
	help
	  Utilities tools for TS-4100 SoM
	  Includes tools to communicate with the supervisory microcontroller,
	  TS-SILO monitor script, interface to FPGA, and ZPU utilities
```

## technologic/package/ts4900-utils/Config.in
```kconfig
config BR2_PACKAGE_TS4900_UTILS
	bool "ts4900-utils"
	help
	  Utilities tools for TS-4900, TS-7970, and TS-7990
	  Includes tools to communicate with the supervisory microcontroller,
	  TS-SILO monitor script, and interface to FPGA
```

## technologic/package/ts7100-utils/Config.in
```kconfig
config BR2_PACKAGE_TS7100_UTILS
	bool "ts7100-utils"
	select BR2_PACKAGE_LIBGPIOD
	help
	  Utilities tools for TS-7100 SBC.

	  Includes tools to communicate with the supervisory
	  microcontroller, the FPGA, and a TS-SILO monitor
	  script.
```

## technologic/package/ts7100z-lvgl-ui-demo/Config.in
```kconfig
config BR2_PACKAGE_TS7100Z_LVGL_UI_DEMO
	bool "ts7100z-lvgl-ui-demo"
	depends on BR2_PACKAGE_LIBLVGL
	depends on BR2_PACKAGE_LV_DRIVERS
	select BR2_PACKAGE_LIBINPUT
	select BR2_PACKAGE_LIBGPIOD
	select BR2_PACKAGE_LIBIIO
	help
	  Simple graphical demo for TS-7100-Z using LVGL

	  Includes the splash-screen image for I/O location reference;
	  control of the two relays; control of the 3 high-voltage,
	  low-side switches; feedback of the input path of those same
	  low-side switches via emulated LEDs; control of the 1
	  high-voltage, high-side switch; and a meter display of the
	  4 0-12 V ADC inputs.

	  libgpiod and libiiod are used for GPIO and ADC control.

comment "ts7100z-lvgl-ui-demo needs liblvgl and lv_drivers"
	depends on !BR2_PACKAGE_LV_DRIVERS
```

## technologic/package/ts7180-utils/Config.in
```kconfig
config BR2_PACKAGE_TS7180_UTILS
	bool "ts7180-utils"
	select BR2_PACKAGE_LIBGPIOD
	help
	  Utilities tools for TS-7180 SBC

	  Includes tools to communicate with the supervisory
	  microcontroller, interface to FPGA, etc.
```

## technologic/package/ts7400v2-utils-linux4x/Config.in
```kconfig
config BR2_PACKAGE_TS7400V2_UTILS_LINUX4X
	bool "ts7400v2-utils-linux4.x"
	help
	  Utilities tools for TS-7400-V2 SBC for use with 4.x and newer kernels.

	  Includes tools to communicate with the supervisory microcontroller,
	  RTC NVRAM, and ADC helper.
```

## technologic/package/ts7553v2-utils/Config.in
```kconfig
config BR2_PACKAGE_TS7553V2_UTILS
	bool "ts7553v2-utils"
	select BR2_PACKAGE_CAIRO
	help
	  Utilities tools for TS-7553-V2 SBC.
	  Includes tools to communicate with the supervisory microcontroller,
	  TS-SILO monitor script, and LCD + KPad interface
```

## technologic/package/ts7670-utils-linux4x/Config.in
```kconfig
config BR2_PACKAGE_TS7670_UTILS_LINUX4X
	bool "ts7670-utils-linux4.x"
	help
	  Utilities tools for TS-7670 SBC for use with 4.x and newer kernels.

	  Includes tools to communicate with the supervisory microcontroller,
	  RTC NVRAM, and RS-485/MODBUS control.
```

## technologic/package/ts7800v2-utils/Config.in
```kconfig
config BR2_PACKAGE_TS7800V2_UTILS
	bool "ts7800v2-utils"
	select BR2_PACKAGE_PROCPS_NG
	help
	  Utilities tools for TS-7800-V2 SBC
	  Includes tools to communicate with the FPGA, peripherals,
	  and various helper scripts
```

## technologic/package/ts7820-utils/Config.in
```kconfig
config BR2_PACKAGE_TS7820_UTILS
	bool "ts7820-utils"
	select BR2_PACKAGE_PROCPS_NG
	help
	  Utilities tools for TS-7820/TS-7840 SBCs.

	  Includes tools to communicate with the supervisory
	  microcontroller and FPGA.
```

## technologic/package/tsmicroctl/Config.in
```kconfig
comment "tsmicroctl is not compatible with the selected platform utilities"
	depends on (BR2_PACKAGE_TS4100_UTILS || BR2_PACKAGE_TS4900_UTILS || \
		BR2_PACKAGE_TS7400V2_UTILS_LINUX4X || BR2_PACKAGE_TS7553V2_UTILS || \
		BR2_PACKAGE_TS7670_UTILS_LINUX4X || BR2_PACKAGE_TS7680_UTILS || \
		BR2_PACKAGE_TS7820_UTILS)

config BR2_PACKAGE_TSMICROCTL
	depends on !(BR2_PACKAGE_TS4100_UTILS || BR2_PACKAGE_TS4900_UTILS || \
		BR2_PACKAGE_TS7400V2_UTILS_LINUX4X || BR2_PACKAGE_TS7553V2_UTILS || \
		BR2_PACKAGE_TS7670_UTILS_LINUX4X || BR2_PACKAGE_TS7680_UTILS || \
		BR2_PACKAGE_TS7820_UTILS)
	bool "tsmicroctl"
	help
	  Standalone utility for interacting with the supervisory microcontroller
	  for TS-7100, TS-7180, and TS-7250-V3.

	  Can be used alongside platform specific utilities for the compatible
	  platforms.

if BR2_PACKAGE_TSMICROCTL

config BR2_PACKAGE_TSMICROCTL_PCT
        string "Trip battery percentage"
        default "90"
        help
	  Initiate a safe reboot process once the external power is removed and
	  the TS-SILO charge level falls below the specified percentage.
endif
```

## technologic/package/tssilomon-init/Config.in
```kconfig
config BR2_PACKAGE_TSSILOMON_INIT
	bool "Install init.d for controlling tssilomon script"
	help
	  The TS products that offer TS-SILO supercapacitor support
	  will have a monitor daemon as part of their utilities
	  repository.

	  By default, the script is installed but does not have a
	  startup process. Enabling this will add a SysV init style
	  script to start and stop the daemon.

	  It is installed as S99tssilomon
```

## technologic/package/tssupervisorupdate/Config.in
```kconfig
config BR2_PACKAGE_TSSUPERVISORUPDATE
	bool "tssupervisorupdate"
	help
	  Tool for updating the supervisory microcntroller on certain
	  embeddedTS platforms.

	  Currently used for:
	  - TS-7250-V3	(>= PCB Rev. B)
	  - TS-7970 	(>= PCB Rev. H)

	  NOTE! There is no harm in running this application on
	  unsupported platforms or PCB revisions. It will return an
	  error however.
```

## technologic/package/wilc-firmware/Config.in
```kconfig
config BR2_PACKAGE_WILC_FIRMWARE
	bool "Microchip ATWILC1000/ATWILC3000 Firmware"
	help
	  External firmware for ATWILC1000/ATWILC3000 devices.

	  These binary blobs are provided directly from Microchip.
	  Ideally, the firmware version should match driver version.
	  Generally, the latest firmware would be acceptible. See
	  the respective kernel for the driver version in order to
	  match the firmware version.

	  These will be installed to /lib/firmware/mchp/

if BR2_PACKAGE_WILC_FIRMWARE

choice
	prompt "Firmware version"
	default BR2_PACKAGE_WILC_FIRMWARE_15_5
	help
	  Select the firmware version


config BR2_PACKAGE_WILC_FIRMWARE_15_5
	bool "v15.5"

config BR2_PACKAGE_WILC_FIRMWARE_15_4
	bool "v15.4"

config BR2_PACKAGE_WILC_FIRMWARE_15_3_1
	bool "v15.3.1"

config BR2_PACKAGE_WILC_FIRMWARE_15_3
	bool "v15.3"

config BR2_PACKAGE_WILC_FIRMWARE_15_2_1
	bool "v15.2.1"

config BR2_PACKAGE_WILC_FIRMWARE_15_2
	bool "v15.2"

config BR2_PACKAGE_WILC_FIRMWARE_15_1
	bool "v15.1"

config BR2_PACKAGE_WILC_FIRMWARE_15_0
	bool "v15.0"

endchoice
endif
```
