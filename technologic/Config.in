## technologic/configs/tsimx9_defconfig
```kconfig
BR2_aarch64=y
BR2_cortex_a55=y
BR2_KERNEL_HEADERS_6_12=y
BR2_TARGET_GENERIC_HOSTNAME="tsimx9"
BR2_ROOTFS_OVERLAY="$(BR2_EXTERNAL_TECHNOLOGIC_PATH)/board/tsimx9/overlay"
BR2_ROOTFS_POST_BUILD_SCRIPT="$(BR2_EXTERNAL_TECHNOLOGIC_PATH)/common/copy-bootscr-post_build.sh"
BR2_LINUX_KERNEL=y
BR2_LINUX_KERNEL_CUSTOM_TARBALL=y
BR2_LINUX_KERNEL_CUSTOM_TARBALL_LOCATION="$(call github,embeddedTS,linux-tsimx,2aa58453c658054a7cb19a9bcdb907606aa1c9d2)/linux-2aa58453c658054a7cb19a9bcdb907606aa1c9d2.tar.gz"
BR2_LINUX_KERNEL_DEFCONFIG="tsimx93"
BR2_LINUX_KERNEL_DTS_SUPPORT=y
BR2_LINUX_KERNEL_INTREE_DTS_NAME="freescale/imx93-ts4300 freescale/imx93-ts9370 freescale/imx93-ts9390"
BR2_LINUX_KERNEL_INTREE_DTSO_NAMES="freescale/imx93-ts4300-16 freescale/imx93-ts4300-16-mipi2dp"
BR2_LINUX_KERNEL_DTB_OVERLAY_SUPPORT=y
BR2_LINUX_KERNEL_INSTALL_TARGET=y
BR2_PACKAGE_BUSYBOX_SHOW_OTHERS=y
BR2_PACKAGE_BUSYBOX_WATCHDOG=y
BR2_PACKAGE_BUSYBOX_WATCHDOG_PERIOD="30"
BR2_PACKAGE_ZSTD=y
BR2_PACKAGE_LINUX_FIRMWARE=y
BR2_PACKAGE_LINUX_FIRMWARE_QUALCOMM_9377_BT=y
BR2_PACKAGE_LINUX_FIRMWARE_ATHEROS_10K_QCA9377=y
BR2_PACKAGE_KMOD=y
BR2_PACKAGE_KMOD_TOOLS=y
BR2_TARGET_ROOTFS_TAR_XZ=y
BR2_PACKAGE_HOST_KMOD_ZSTD=y
BR2_PACKAGE_HOST_UBOOT_TOOLS=y
BR2_PACKAGE_HOST_UBOOT_TOOLS_BOOT_SCRIPT=y
BR2_PACKAGE_HOST_UBOOT_TOOLS_BOOT_SCRIPT_SOURCE="$(BR2_EXTERNAL_TECHNOLOGIC_PATH)/board/tsimx9/boot.source"
BR2_PACKAGE_HOST_ZSTD=y
BR2_PACKAGE_NXP_BT_WIFI_FIRMWARE_ETS=y
BR2_PACKAGE_NXP_BT_WIFI_FIRMWARE_ETS_IW612=y
BR2_PACKAGE_NXP_MWIFIEX_ETS=y
```

## technologic/configs/tsimx9_usbprod_defconfig
```kconfig
BR2_aarch64=y
BR2_cortex_a55=y
BR2_KERNEL_HEADERS_6_12=y
BR2_TOOLCHAIN_BUILDROOT_CXX=y
BR2_TARGET_GENERIC_HOSTNAME="tsimx9"
BR2_TARGET_GENERIC_ISSUE="tsimx9 production environment"
BR2_ROOTFS_OVERLAY="$(BR2_EXTERNAL_TECHNOLOGIC_PATH)/board/usbprod-common/overlay"
BR2_ROOTFS_POST_BUILD_SCRIPT="$(BR2_EXTERNAL_TECHNOLOGIC_PATH)/board/usbprod-common/scripts/post-build.sh"
BR2_ROOTFS_POST_IMAGE_SCRIPT="$(BR2_EXTERNAL_TECHNOLOGIC_PATH)/board/usbprod-common/scripts/post-image.sh"
BR2_ROOTFS_POST_SCRIPT_ARGS="tsimx9"
BR2_LINUX_KERNEL=y
BR2_LINUX_KERNEL_CUSTOM_TARBALL=y
BR2_LINUX_KERNEL_CUSTOM_TARBALL_LOCATION="$(call github,embeddedTS,linux-tsimx,2aa58453c658054a7cb19a9bcdb907606aa1c9d2)/linux-2aa58453c658054a7cb19a9bcdb907606aa1c9d2.tar.gz"
BR2_LINUX_KERNEL_DEFCONFIG="tsimx93"
BR2_LINUX_KERNEL_DTS_SUPPORT=y
BR2_LINUX_KERNEL_INTREE_DTS_NAME="freescale/imx93-ts4300 freescale/imx93-ts9370 freescale/imx93-ts9390"
BR2_LINUX_KERNEL_INTREE_DTSO_NAMES="freescale/imx93-ts4300-16 freescale/imx93-ts4300-16-mipi2dp"
BR2_LINUX_KERNEL_DTB_OVERLAY_SUPPORT=y
BR2_PACKAGE_BUSYBOX_SHOW_OTHERS=y
BR2_PACKAGE_BUSYBOX_WATCHDOG=y
BR2_PACKAGE_BUSYBOX_WATCHDOG_PERIOD="30"
BR2_PACKAGE_BZIP2=y
BR2_PACKAGE_XZ=y
BR2_PACKAGE_ZSTD=y
BR2_PACKAGE_E2FSPROGS=y
BR2_PACKAGE_E2FSPROGS_RESIZE2FS=y
BR2_PACKAGE_GPTFDISK=y
BR2_PACKAGE_GPTFDISK_SGDISK=y
BR2_PACKAGE_PARTED=y
BR2_PACKAGE_RNG_TOOLS=y
BR2_PACKAGE_UBOOT_TOOLS=y
BR2_PACKAGE_UBOOT_TOOLS_FIT_SUPPORT=y
BR2_PACKAGE_UBOOT_TOOLS_FIT_SIGNATURE_SUPPORT=y
BR2_PACKAGE_UBOOT_TOOLS_FIT_CHECK_SIGN=y
BR2_PACKAGE_UBOOT_TOOLS_MKIMAGE=y
BR2_PACKAGE_UBOOT_TOOLS_MKENVIMAGE=y
BR2_PACKAGE_LIBOPENSSL_ENGINES=y
BR2_PACKAGE_COREUTILS=y
BR2_PACKAGE_KMOD=y
BR2_PACKAGE_KMOD_TOOLS=y
BR2_PACKAGE_UTIL_LINUX_PARTX=y
BR2_TARGET_ROOTFS_CPIO=y
BR2_TARGET_ROOTFS_CPIO_GZIP=y
BR2_PACKAGE_HOST_GENEXT2FS=y
BR2_PACKAGE_HOST_GENIMAGE=y
BR2_PACKAGE_HOST_KMOD_ZSTD=y
BR2_PACKAGE_HOST_PKGCONF=y
BR2_PACKAGE_HOST_UBOOT_TOOLS=y
BR2_PACKAGE_HOST_ZSTD=y
BR2_PACKAGE_GROWPART=y
BR2_PACKAGE_TSSUPERVISORUPDATE=y
```

## technologic/package/growpart/Config.in
```kconfig
config BR2_PACKAGE_GROWPART
	bool "growpart"
	select BR2_PACKAGE_UTIL_LINUX_BINARIES
	help
	  Script to automatically resize a partition.

	  This has the advantage of being able to run every time, if the disk
	  cannot reasonably be expanded, the command will indicate so via return.
	  This allows for it to be run safely every boot and only actually affect
	  a disk on first run.

	  growpart is provided as a script in the toolset cloud-utils. This
	  package installs just the growpart script and none of the other tools.
```

## technologic/package/idleinject/Config.in
```kconfig
config BR2_PACKAGE_IDLEINJECT
	bool "idleinject"
	select BR2_PACKAGE_PROCPS_NG
	help
	  Userspace CPU Idle Injector

	  Intended for a38x CPUs which do not have correct in-kernel
	  thermal throttling support at this time. Compatible with
	  nearly every other CPU as well.

	  Monitors thermal zone 0 and pauses userspace applications in
	  situations when temperatures are running high.

if BR2_PACKAGE_IDLEINJECT

config BR2_PACKAGE_IDLEINJECT_MAXTEMP
	string "Thermal trip temperature (in millicelcius)"
	default "115000"
	help
	  Temperature, in millicelcius, when the idleinject tool kicks
	  in and pauses userspace processes to reduce CPU temperature.

config BR2_PACKAGE_IDLEINJECT_REDLED
	bool "Turn on red LED when idleinject is throttling"
	help
	  Turn on the red:system LED if the thermal trip temperature is
	  reached and the idleinject tool pauses userpace processes.

endif
```

## technologic/package/liblvgl/Config.in
```kconfig
config BR2_PACKAGE_LIBLVGL
	bool "liblvgl"
	help
	  Build and install libraries to support the
	  Light and Versatile Graphics Library (LVGL). This requires
	  an externally provided lv_conf.h file to handle the build
	  configuration.

config BR2_PACKAGE_LIBLVGL_LVCONF
	string "Path to lv_conf.h to build against"
	depends on BR2_PACKAGE_LIBLVGL
	help
	  Path to the lv_conf.h file used to configure the LVGL build.

	  Note that this is required in order to build a useful LVGL
	  library!

	  The path can be a URL beginning with ftp://, http://,
	  or https://. Otherwise, it will be assumed to be a file on
	  disk and will be copied from that path.
```

## technologic/package/linux-firmware-qca9377/Config.in
```kconfig
config BR2_PACKAGE_LINUX_FIRMWARE_QCA9377
	bool "linux-firmware-qca9377"
	help
	  This is a transition package to support BT on the Silex
	  Wi-Fi / BT module on embeddedTS platforms. Support for
	  installing this firmware normally has been proposed upstream,
	  but this is added here until that makes it in to a release.

	  This package provides various binary firmware files (closed
	  binary blobs) for such devices like LAN, WLAN cards etc.

	  https://git.kernel.org/?p=linux/kernel/git/firmware/linux-firmware.git

if BR2_PACKAGE_LINUX_FIRMWARE_QCA9377

menu "Bluetooth firmware"

config BR2_PACKAGE_LINUX_FIRMWARE_QUALCOMM_9377_BT
	bool "Qualcomm Atheros QCA9377 Bluetooth"
	help
	  Firmware files for QCA9377 bluetooth support.

endmenu # Bluetooth

endif
```

## technologic/package/lv_drivers/Config.in
```kconfig
config BR2_PACKAGE_LV_DRIVERS
	bool "lv_drivers"
	depends on BR2_PACKAGE_LIBLVGL
	help
	  Drivers package for LVGL. This provides a number of interface
	  routines for things such as libinput, fbdev, wayland, etc. It
	  builds and installs libraries to the target and provides
	  headers and libraries for compilation of other packages.

	  This requires LVGL to be enabled and built. This will have
	  access to lv_conf.h already from LVGL. Additionally, another
	  configuration file, lv_drv_conf.h, is needed by lv_drivers in
	  order to configure the build properly.

comment "lv_drivers needs liblvgl"
	depends on !BR2_PACKAGE_LIBLVGL

config BR2_PACKAGE_LV_DRIVERS_LVDRVCONF
	string "Path to lv_drv_conf.h to build against"
	depends on BR2_PACKAGE_LV_DRIVERS
	help
	  Path to the lv_drv_conf.h file used to configure the
	  lv_drviers build.

	  Note that this is required in order to build a useful
	  lv_drivers library!

	  The path can be a URL beginning with ftp://, http://,
	  or https://. Otherwise, it will be assumed to be a file on
	  disk and will be copied from that path.
```
